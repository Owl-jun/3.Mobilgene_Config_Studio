AUTOSAR XML (schema 4-0-3)
package /AUTOSAR
  module config Dcm: implementation-config-variant=VARIANT-PRE-COMPILE, module-description=BswImplementation_Dcm
    DcmConfigSet
      DcmDsd
        ES95486_SERVICE (DcmDsdServiceTable): DcmDsdSidTabId=0x00
          19 x DcmDsdService:
            SID10_DiagnosticSessionControl: DcmDsdSidTabServiceId=0x10, DcmDsdSidTabSubfuncAvail=1, DcmDsdServiceRole=0xFF, DcmDsdSidTabSessionLevelRef=DCM_ALL_SESSION_LEVEL
              7 x DcmDsdSubService:
                defaultSession: DcmDsdSubServiceId=0x01, DcmDsdSubServiceRole=0xFF
                programmingSession: DcmDsdSubServiceId=0x02, DcmDsdSubServiceSessionLevelRef=DCM_DEFAULT_SESSION, DcmDsdSubServiceSessionLevelRef=DCM_PROGRAMMING_SESSION, DcmDsdSubServiceSessionLevelRef=DCM_EXTENDED_DIAGNOSTIC_SESSION, DcmDsdSubServiceSessionLevelRef=DCM_ECU_PROGRAMMING_MODE, DcmDsdSubServiceSessionLevelRef=DCM_EXTENDED_DIAGNOSTIC_MODE
                extendedDiagnosticSession: DcmDsdSubServiceId=0x03, DcmDsdSubServiceSessionLevelRef=DCM_DEFAULT_SESSION, DcmDsdSubServiceSessionLevelRef=DCM_EXTENDED_DIAGNOSTIC_MODE, DcmDsdSubServiceSessionLevelRef=DCM_EXTENDED_DIAGNOSTIC_SESSION, DcmDsdSubServiceSessionLevelRef=DCM_SAFETY_SYSTEM_DIAGNOSTIC_SESSION
                safetySystemDiagnosticSession: DcmDsdSubServiceId=0x04, DcmDsdSubServiceSessionLevelRef=DCM_DEFAULT_SESSION, DcmDsdSubServiceSessionLevelRef=DCM_EXTENDED_DIAGNOSTIC_MODE, DcmDsdSubServiceSessionLevelRef=DCM_EXTENDED_DIAGNOSTIC_SESSION, DcmDsdSubServiceSessionLevelRef=DCM_SAFETY_SYSTEM_DIAGNOSTIC_SESSION
                extended_diagnostic_mode: DcmDsdSubServiceId=0x10, DcmDsdSubServiceSessionLevelRef=DCM_DEFAULT_SESSION, DcmDsdSubServiceSessionLevelRef=DCM_EXTENDED_DIAGNOSTIC_MODE, DcmDsdSubServiceSessionLevelRef=DCM_EXTENDED_DIAGNOSTIC_SESSION, DcmDsdSubServiceSessionLevelRef=DCM_SAFETY_SYSTEM_DIAGNOSTIC_SESSION
                quiescent_current_diagnostic_mode: DcmDsdSubServiceId=0x50, DcmDsdSubServiceSessionLevelRef=DCM_DEFAULT_SESSION, DcmDsdSubServiceSessionLevelRef=DCM_QUIESCENT_CURRENT_DIAGNOSTIC_MODE
                sleep_mode_start_request: DcmDsdSubServiceId=0x51
            SID11_ECUReset: DcmDsdSidTabServiceId=0x11, DcmDsdSidTabSubfuncAvail=1, DcmDsdSidTabSessionLevelRef=DCM_DEFAULT_SESSION, DcmDsdSidTabSessionLevelRef=DCM_PROGRAMMING_SESSION, DcmDsdSidTabSessionLevelRef=DCM_ECU_PROGRAMMING_MODE, DcmDsdSidTabSessionLevelRef=DCM_EXTENDED_DIAGNOSTIC_MODE, DcmDsdSidTabSessionLevelRef=DCM_EXTENDED_DIAGNOSTIC_SESSION, DcmDsdSidTabSessionLevelRef=DCM_SAFETY_SYSTEM_DIAGNOSTIC_SESSION
              hardReset (DcmDsdSubService): DcmDsdSubServiceId=0x01
            SID27_SecurityAccess: DcmDsdSidTabServiceId=0x27, DcmDsdSidTabSubfuncAvail=1, DcmDsdSidTabSessionLevelRef=DCM_PROGRAMMING_SESSION, DcmDsdSidTabSessionLevelRef=DCM_ECU_PROGRAMMING_MODE, DcmDsdSidTabSessionLevelRef=DCM_EXTENDED_DIAGNOSTIC_MODE, DcmDsdSidTabSessionLevelRef=DCM_EXTENDED_DIAGNOSTIC_SESSION, DcmDsdSidTabSessionLevelRef=DCM_SAFETY_SYSTEM_DIAGNOSTIC_SESSION
              GetSeed_HSAC (DcmDsdSubService): DcmDsdSubServiceId=0x11
              CompareKey_HSAC (DcmDsdSubService): DcmDsdSubServiceId=0x12
            SID28_CommunicationControl: DcmDsdSidTabServiceId=0x28, DcmDsdSidTabSubfuncAvail=1, DcmDsdSidTabSessionLevelRef=DCM_PROGRAMMING_SESSION, DcmDsdSidTabSessionLevelRef=DCM_ECU_PROGRAMMING_MODE, DcmDsdSidTabSessionLevelRef=DCM_EXTENDED_DIAGNOSTIC_MODE, DcmDsdSidTabSessionLevelRef=DCM_EXTENDED_DIAGNOSTIC_SESSION
              4 x DcmDsdSubService:
                enableRxAndTx: DcmDsdSubServiceId=0x00
                disableNormalMessageTransmission: DcmDsdSubServiceId=0x01
                disableRxAndEnableTx: DcmDsdSubServiceId=0x02
                disableRxAndTx: DcmDsdSubServiceId=0x03
            SID29_EnableNormalMsgTransmission: DcmDsdSidTabServiceId=0x29, DcmDsdSidTabSubfuncAvail=1, DcmDsdSidTabSessionLevelRef=DCM_PROGRAMMING_SESSION, DcmDsdSidTabSessionLevelRef=DCM_ECU_PROGRAMMING_MODE, DcmDsdSidTabSessionLevelRef=DCM_EXTENDED_DIAGNOSTIC_SESSION, DcmDsdSidTabSessionLevelRef=DCM_EXTENDED_DIAGNOSTIC_MODE
              responseRequired (DcmDsdSubService): DcmDsdSubServiceId=0x01
              noResponseRequired (DcmDsdSubService): DcmDsdSubServiceId=0x02
            SID3E_TesterPresent: DcmDsdSidTabServiceId=0x3E, DcmDsdSidTabSubfuncAvail=1, DcmDsdSidTabSessionLevelRef=DCM_DEFAULT_SESSION, DcmDsdSidTabSessionLevelRef=DCM_PROGRAMMING_SESSION, DcmDsdSidTabSessionLevelRef=DCM_ECU_PROGRAMMING_MODE, DcmDsdSidTabSessionLevelRef=DCM_EXTENDED_DIAGNOSTIC_MODE, DcmDsdSidTabSessionLevelRef=DCM_EXTENDED_DIAGNOSTIC_SESSION, DcmDsdSidTabSessionLevelRef=DCM_SAFETY_SYSTEM_DIAGNOSTIC_SESSION
              zeroSubFunction (DcmDsdSubService): DcmDsdSubServiceId=0x00
            SID85_ControlDTCSetting: DcmDsdSidTabServiceId=0x85, DcmDsdSidTabSubfuncAvail=1, DcmDsdSidTabSessionLevelRef=DCM_PROGRAMMING_SESSION, DcmDsdSidTabSessionLevelRef=DCM_ECU_PROGRAMMING_MODE, DcmDsdSidTabSessionLevelRef=DCM_EXTENDED_DIAGNOSTIC_SESSION, DcmDsdSidTabSessionLevelRef=DCM_EXTENDED_DIAGNOSTIC_MODE
              On (DcmDsdSubService): DcmDsdSubServiceId=0x01
              Off (DcmDsdSubService): DcmDsdSubServiceId=0x02
            SID20_StopDiagnosticSession: DcmDsdSidTabServiceId=0x20, DcmDsdSidTabSubfuncAvail=0, DcmDsdSidTabSessionLevelRef=DCM_DEFAULT_SESSION, DcmDsdSidTabSessionLevelRef=DCM_PROGRAMMING_SESSION, DcmDsdSidTabSessionLevelRef=DCM_ECU_PROGRAMMING_MODE, DcmDsdSidTabSessionLevelRef=DCM_EXTENDED_DIAGNOSTIC_SESSION, DcmDsdSidTabSessionLevelRef=DCM_EXTENDED_DIAGNOSTIC_MODE
            SID22_ReadDataByIdentifier: DcmDsdSidTabServiceId=0x22, DcmDsdSidTabSubfuncAvail=0, DcmDsdSidTabSessionLevelRef=DCM_DEFAULT_SESSION, DcmDsdSidTabSessionLevelRef=DCM_EXTENDED_DIAGNOSTIC_MODE, DcmDsdSidTabSessionLevelRef=DCM_EXTENDED_DIAGNOSTIC_SESSION, DcmDsdSidTabSessionLevelRef=DCM_SAFETY_SYSTEM_DIAGNOSTIC_SESSION, DcmDsdSidTabSessionLevelRef=DCM_QUIESCENT_CURRENT_DIAGNOSTIC_MODE
            SID23_ReadMemoryByAddress: DcmDsdSidTabServiceId=0x23, DcmDsdSidTabSubfuncAvail=0, DcmDsdSidTabSessionLevelRef=DCM_DEFAULT_SESSION, DcmDsdSidTabSessionLevelRef=DCM_EXTENDED_DIAGNOSTIC_SESSION, DcmDsdSidTabSessionLevelRef=DCM_EXTENDED_DIAGNOSTIC_MODE
            SID2E_WriteDataByIdentifier: DcmDsdSidTabServiceId=0x2E, DcmDsdSidTabSubfuncAvail=0, DcmDsdSidTabSessionLevelRef=DCM_PROGRAMMING_SESSION, DcmDsdSidTabSessionLevelRef=DCM_ECU_PROGRAMMING_MODE, DcmDsdSidTabSessionLevelRef=DCM_EXTENDED_DIAGNOSTIC_MODE, DcmDsdSidTabSessionLevelRef=DCM_EXTENDED_DIAGNOSTIC_SESSION, DcmDsdSidTabSessionLevelRef=DCM_SAFETY_SYSTEM_DIAGNOSTIC_SESSION
            SID3D_WriteMemoryByAddress: DcmDsdSidTabServiceId=0x3D, DcmDsdSidTabSubfuncAvail=0, DcmDsdSidTabSessionLevelRef=DCM_DEFAULT_SESSION, DcmDsdSidTabSessionLevelRef=DCM_PROGRAMMING_SESSION, DcmDsdSidTabSessionLevelRef=DCM_ECU_PROGRAMMING_MODE, DcmDsdSidTabSessionLevelRef=DCM_EXTENDED_DIAGNOSTIC_MODE, DcmDsdSidTabSessionLevelRef=DCM_EXTENDED_DIAGNOSTIC_SESSION
            SID19_ReadDTCInformation: DcmDsdSidTabServiceId=0x19, DcmDsdSidTabSubfuncAvail=1, DcmDsdSidTabSessionLevelRef=DCM_DEFAULT_SESSION, DcmDsdSidTabSessionLevelRef=DCM_EXTENDED_DIAGNOSTIC_SESSION, DcmDsdSidTabSessionLevelRef=DCM_EXTENDED_DIAGNOSTIC_MODE
              reportNumberOfDTCByStatusMask (DcmDsdSubService): DcmDsdSubServiceId=0x01
              reportDTCByStatusMask (DcmDsdSubService): DcmDsdSubServiceId=0x02
            SID14_ClearDiagnosticInformation: DcmDsdSidTabServiceId=0x14, DcmDsdSidTabSubfuncAvail=0, DcmDsdSidTabSessionLevelRef=DCM_DEFAULT_SESSION, DcmDsdSidTabSessionLevelRef=DCM_EXTENDED_DIAGNOSTIC_SESSION, DcmDsdSidTabSessionLevelRef=DCM_EXTENDED_DIAGNOSTIC_MODE
            SID2F_InputOutputControlByIdentifier: DcmDsdSidTabServiceId=0x2F, DcmDsdSidTabSubfuncAvail=0, DcmDsdSidTabSessionLevelRef=DCM_EXTENDED_DIAGNOSTIC_MODE, DcmDsdSidTabSessionLevelRef=DCM_EXTENDED_DIAGNOSTIC_SESSION
            SID31_RoutineControl: DcmDsdSidTabServiceId=0x31, DcmDsdSidTabSubfuncAvail=1, DcmDsdSidTabSessionLevelRef=DCM_DEFAULT_SESSION, DcmDsdSidTabSessionLevelRef=DCM_PROGRAMMING_SESSION, DcmDsdSidTabSessionLevelRef=DCM_ECU_PROGRAMMING_MODE, DcmDsdSidTabSessionLevelRef=DCM_EXTENDED_DIAGNOSTIC_MODE, DcmDsdSidTabSessionLevelRef=DCM_EXTENDED_DIAGNOSTIC_SESSION, DcmDsdSidTabSessionLevelRef=DCM_SAFETY_SYSTEM_DIAGNOSTIC_SESSION
              3 x DcmDsdSubService:
                startRoutine: DcmDsdSubServiceId=0x01
                stopRoutine: DcmDsdSubServiceId=0x02
                requestRoutineResults: DcmDsdSubServiceId=0x03
            SID34_RequestDownload: DcmDsdSidTabServiceId=0x34, DcmDsdSidTabSubfuncAvail=0, DcmDsdSidTabSessionLevelRef=DCM_EXTENDED_DIAGNOSTIC_SESSION, DcmDsdSidTabSessionLevelRef=DCM_PROGRAMMING_SESSION
            SID36_TransferData: DcmDsdSidTabSubfuncAvail=0, DcmDsdSidTabServiceId=0x36, DcmDsdSidTabSessionLevelRef=DCM_EXTENDED_DIAGNOSTIC_SESSION, DcmDsdSidTabSessionLevelRef=DCM_PROGRAMMING_SESSION
            SID37_RequestTransferExit: DcmDsdSidTabSubfuncAvail=0, DcmDsdSidTabServiceId=0x37, DcmDsdSidTabSessionLevelRef=DCM_EXTENDED_DIAGNOSTIC_SESSION, DcmDsdSidTabSessionLevelRef=DCM_PROGRAMMING_SESSION
      DcmDsl: category=TOOL_CONFIGURED
        UDS_RX (DcmDslBuffer): DcmDslBufferSize=0xFF
        UDS_TX (DcmDslBuffer): DcmDslBufferSize=0xFF
        ECU1 (DcmDslCallbackDCMRequestService)
        DcmDslDiagResp: DcmDslDiagRespMaxNumRespPend=0x32, DcmDslDiagRespOnSecondDeclinedRequest=0
        Dcm_DiagCom_Protocol (DcmDslProtocol): category=TOOL_CONFIGURED
          UDS_ON_CAN (DcmDslProtocolRow):
            category = TOOL_CONFIGURED
            DcmDslProtocolEndiannessConvEnabled = 0
            DcmDslProtocolID = DCM_UDS_ON_CAN
            DcmDslProtocolIsParallelExecutab = 1
            DcmDslProtocolPreemptTimeout = 0.01
            DcmDslProtocolPriority = 0x01
            DcmDslProtocolTransType = TYPE2
            DcmSendRespPendOnTransToBoot = 1
            DcmTimStrP2ServerAdjust = 0.02
            DcmTimStrP2StarServerAdjust = 2.5
            DcmDslProtocolRxBufferID = UDS_RX
            DcmDslProtocolSIDTable = ES95486_SERVICE
            DcmDslProtocolSessionRef = ES95486_SESSION
            DcmDslProtocolTxBufferID = UDS_TX
            UDS_ON_CAN (DcmDslConnection): category=TOOL_CONFIGURED
              DcmDslMainConnection: category=TOOL_CONFIGURED, DcmDslProtocolRxTesterSourceAddr=0xF0, DcmDslProtocolRxConnectionId=0x00
                PhysicalRequest (DcmDslProtocolRx):
                  category = TOOL_CONFIGURED
                  DcmDslProtocolRxAddrType = DCM_PHYSICAL_TYPE
                  DcmDslProtocolRxPduId = 0x00
                  DcmDslProtocolRxChannelId = 0x00
                  DcmDslProtocolRxComMChannelRef = ComMChannel_LCAN
                  DcmDslProtocolRxPduRef = Pdu_DcmIPdu_LCAN_GstBDCUWB_BLE
                FunctionalRequest (DcmDslProtocolRx):
                  category = TOOL_CONFIGURED
                  DcmDslProtocolRxAddrType = DCM_FUNCTIONAL_TYPE
                  DcmDslProtocolRxPduId = 0x01
                  DcmDslProtocolRxChannelId = 0x00
                  DcmDslProtocolRxComMChannelRef = ComMChannel_LCAN
                  DcmDslProtocolRxPduRef = Pdu_DcmIPdu_LCAN_Gst_ALL
                Response (DcmDslProtocolTx): category=TOOL_CONFIGURED, DcmDslTxConfirmationPduId=0x00, DcmDslProtocolTxPduRef=Pdu_DcmIPdu_LCAN_UWB_BLEBDCGst
        DcmDslServiceRequestSupplierNotification0 (DcmDslServiceRequestSupplierNotification)
      DcmDsp:
        DcmDspMaxDidToRead = 0x20
        DcmDspPowerDownTime = 0x0A
        DcmDspMaxPeriodicDidScheduler = 0x02
        DcmDspMaxPeriodicDidToRead = 0x02
        DcmDspDDDIDcheckPerSourceDID = 0
        9 x DcmDspData, all with DcmDspDataType=UINT8, DcmDspDataUsePort=USE_DATA_SYNCH_CLIENT_SERVER:
          VehicleManufacturerECUSoftwareVersionNumber: DcmDspDataSize=0x88, DcmDspDataInfoRef=NoScalingInfomation_FixedData
          SystemSupplierECUHardwareVersionNumber: DcmDspDataSize=0x20, DcmDspDataInfoRef=NoScalingInfomation_FixedData
          SystemSupplierECUSoftwareNumber: DcmDspDataSize=0x20, DcmDspDataInfoRef=NoScalingInfomation_FixedData
          VehicleSpeed: DcmDspDataSize=0x08, DcmDspDataInfoRef=VehicleSpeed_FixedData
          ActuatorControl: DcmDspDataSize=0x08, DcmDspDataInfoRef=NoScalingInfomation_FixedData
          VINDataIdentifier: DcmDspDataSize=0x88, DcmDspDataInfoRef=VIN_DataIdentifier
          BatVolt: DcmDspDataSize=0x08, DcmDspDataInfoRef=NoScalingInfomation_FixedData
          RPM: DcmDspDataSize=0x10, DcmDspDataInfoRef=NoScalingInfomation_FixedData
          ECT: DcmDspDataSize=0x08, DcmDspDataInfoRef=NoScalingInfomation_FixedData
        4 x DcmDspDataInfo:
          VehicleSpeed_FixedData: DcmDspDataFixedLength=1, DcmDspDataScalingInfoSize=0x09
          NoScalingInfomation_FixedData: DcmDspDataFixedLength=1
          NoScalingInfomation_VariableData: DcmDspDataFixedLength=0
          VIN_DataIdentifier: DcmDspDataFixedLength=1, DcmDspDataScalingInfoSize=0x02
        14 x DcmDspDid, all with DcmDspDidUsed=1:
          DID_0201h_VehicleSpeed: DcmDspDidIdentifier=0x201, DcmDspDidInfoRef=DIDInfo_0201h_VehicleSpeed
            VehicleSpeed (DcmDspDidSignal): DcmDspDidDataPos=0x00, DcmDspDidDataRef=DcmDsp/VehicleSpeed
          DID_F189h_VehicleManufacturerECUSoftwareVersionNumber: DcmDspDidIdentifier=0xF189, DcmDspDidInfoRef=DID_F189h_VehicleManufacturerECUSoftwareVersionNumber
            VehicleManufacturerECUSoftwareVersionNumber (DcmDspDidSignal): DcmDspDidDataPos=0x00, DcmDspDidDataRef=DcmDsp/VehicleManufacturerECUSoftwareVersionNumber
          DID_F193h_SystemSupplierECUHardwareVersionNumber: DcmDspDidIdentifier=0xF193, DcmDspDidInfoRef=DID_F193h_SystemSupplierECUHardwareVersionNumber
            SystemSupplierECUHardwareVersionNumber (DcmDspDidSignal): DcmDspDidDataPos=0x00, DcmDspDidDataRef=DcmDsp/SystemSupplierECUHardwareVersionNumber
          DID_F194h_SystemSupplierECUSoftwareNumber: DcmDspDidIdentifier=0xF194, DcmDspDidInfoRef=DID_F194h_SystemSupplierECUSoftwareNumber
            SystemSupplierECUSoftwareNumber (DcmDspDidSignal): DcmDspDidDataPos=0x00, DcmDspDidDataRef=DcmDsp/SystemSupplierECUSoftwareNumber
          DID_F190h_VINDataIdentifier: DcmDspDidIdentifier=0xF190, DcmDspDidInfoRef=DID_F190h_VINDataIdentifier
            DcmDspDidSignal: DcmDspDidDataPos=0x00, DcmDspDidDataRef=VINDataIdentifier
          DID_010A: DcmDspDidIdentifier=0x10A, DcmDspDidInfoRef=DID_010Ah
            3 x DcmDspDidSignal:
              BatVolt: DcmDspDidDataPos=0x00, DcmDspDidDataRef=DcmDsp/BatVolt
              RPM: DcmDspDidDataPos=0x08, DcmDspDidDataRef=DcmDsp/RPM
              ECT: DcmDspDidDataPos=0x18, DcmDspDidDataRef=DcmDsp/ECT
          DDID_F301h: DcmDspDidIdentifier=0xF301, DcmDspDidInfoRef=DDID_F301
          DDID_F302: DcmDspDidIdentifier=0xF302, DcmDspDidInfoRef=DDID_F302h
          DDID_F303: DcmDspDidIdentifier=0xF303, DcmDspDidInfoRef=DDID_F303h
          IO_F010h_ActuatorControl: DcmDspDidIdentifier=0xF010, DcmDspDidInfoRef=IO_F010h_ActuatorControl
            ActuatorControl (DcmDspDidSignal): DcmDspDidDataPos=0x00, DcmDspDidDataRef=DcmDsp/ActuatorControl
          IO_F012h_MultipleActuatorControl: DcmDspDidIdentifier=0xF012, DcmDspDidInfoRef=IO_F010h_MultiActuatorControl
            ActuatorControl (DcmDspDidSignal): DcmDspDidDataPos=0x00, DcmDspDidDataRef=DcmDsp/ActuatorControl
            RPM (DcmDspDidSignal): DcmDspDidDataPos=0x08, DcmDspDidDataRef=DcmDsp/RPM
          PDID_F2E3: DcmDspDidIdentifier=0xF2E3, DcmDspDidInfoRef=pDID_F2E3h
            AC (DcmDspDidSignal): DcmDspDidDataPos=0x00, DcmDspDidDataRef=DcmDsp/ActuatorControl
            BatVolt (DcmDspDidSignal): DcmDspDidDataPos=0x08, DcmDspDidDataRef=DcmDsp/BatVolt
          PDID_F224: DcmDspDidIdentifier=0xF224, DcmDspDidInfoRef=pDID_F2E3h
            RPM (DcmDspDidSignal): DcmDspDidDataPos=0x00, DcmDspDidDataRef=DcmDsp/RPM
            ECT (DcmDspDidSignal): DcmDspDidDataPos=0x10, DcmDspDidDataRef=DcmDsp/ECT
          PDID_F232: DcmDspDidIdentifier=0xF232, DcmDspDidInfoRef=PDID_F232h
            3 x DcmDspDidSignal:
              BatVolt: DcmDspDidDataPos=0x00, DcmDspDidDataRef=DcmDsp/BatVolt
              RPM: DcmDspDidDataPos=0x08, DcmDspDidDataRef=DcmDsp/RPM
              ECT: DcmDspDidDataPos=0x20, DcmDspDidDataRef=DcmDsp/ECT
        8 x DcmDspDidInfo:
          DIDInfo_0201h_VehicleSpeed: DcmDspDidDynamicallyDefined=0
            DcmDspDidAccess
              DcmDspDidRead
          DID_010Ah: DcmDspDidDynamicallyDefined=0
            DcmDspDidAccess
              DcmDspDidRead: DcmDspDDDIDMaxElements=0x02
          DDID_F302h: DcmDspDidDynamicallyDefined=1
            DcmDspDidAccess
              DcmDspDidRead: DcmDspDDDIDMaxElements=0x03
          DDID_F303h: DcmDspDidDynamicallyDefined=1
            DcmDspDidAccess
              DcmDspDidRead: DcmDspDDDIDMaxElements=0x04
          IO_F010h_MultiActuatorControl: DcmDspDidDynamicallyDefined=0
            DcmDspDidAccess
              DcmDspDidControl:
                DcmDspDidFreezeCurrentState = 1
                DcmDspDidResetToDefault = 0
                DcmDspDidReturnControlToEcu = 1
                DcmDspDidShortTermAdjustment = 1
                DcmDspDidControlSessionRef = DCM_EXTENDED_DIAGNOSTIC_SESSION
              DcmDspDidRead: DcmDspDidReadSessionRef=DCM_EXTENDED_DIAGNOSTIC_SESSION
          pDID_F2E3h: DcmDspDidDynamicallyDefined=0
            DcmDspDidAccess
              DcmDspDidRead: DcmDspDidReadSessionRef=DCM_EXTENDED_DIAGNOSTIC_SESSION
              DcmDspDidWrite: DcmDspDidWriteSessionRef=DCM_EXTENDED_DIAGNOSTIC_SESSION
          PDID_F232h: DcmDspDidDynamicallyDefined=0
            DcmDspDidAccess
              DcmDspDidRead: DcmDspDidReadSessionRef=DCM_EXTENDED_DIAGNOSTIC_MODE
          pDID_F224h: DcmDspDidDynamicallyDefined=0
            DcmDspDidAccess
              DcmDspDidRead: DcmDspDidReadSessionRef=DCM_EXTENDED_DIAGNOSTIC_MODE, DcmDspDidReadSessionRef=DCM_EXTENDED_DIAGNOSTIC_SESSION
              DcmDspDidWrite: DcmDspDidWriteSessionRef=DCM_EXTENDED_DIAGNOSTIC_MODE, DcmDspDidWriteSessionRef=DCM_EXTENDED_DIAGNOSTIC_SESSION
        DIDs_0100h_0110h (DcmDspDidRange):
          DcmDspDidRangeHasGaps = 1
          DcmDspDidRangeIdentifierLowerLimit = 0x100
          DcmDspDidRangeIdentifierUpperLimit = 0x110
          DcmDspDidRangeMaxDataLength = 0x1E
          DcmDspDidRangeUsePort = 1
          DcmDspDidRangeInfoRef = DIDs_0100h_0110h
        DcmDspMemory: DcmDspUseMemoryId=0
          3 x DcmDspAddressAndLengthFormatIdentifier:
            ALF_0x14h: DcmDspSupportedAddressAndLengthFormatIdentifier=0x14
            ALF_0x34h: DcmDspSupportedAddressAndLengthFormatIdentifier=0x34
            ALF_0x44h: DcmDspSupportedAddressAndLengthFormatIdentifier=0x44
          MemoryIdInfo (DcmDspMemoryIdInfo)
            RMA_21091968h (DcmDspReadMemoryRangeInfo): DcmDspReadMemoryRangeHigh=0x2109196C, DcmDspReadMemoryRangeLow=0x21091968
            WMA_20481309h (DcmDspWriteMemoryRangeInfo): DcmDspWriteMemoryRangeHigh=0x2048130E, DcmDspWriteMemoryRangeLow=0x20481309
        RID_0200h_CalibrationActuator (DcmDspRoutine):
          DcmDspRequestResultsRoutineSupported = 1
          DcmDspRoutineFixedLength = 1
          DcmDspRoutineIdentifier = 0x200
          DcmDspRoutineUsePort = 1
          DcmDspRoutineUsed = 1
          DcmDspStopRoutineSupported = 1
          DcmDspRoutineInfoRef = RID_0200h_CalibrationActuator
        ES95486_SECURITY (DcmDspSecurity)
          L9 (DcmDspSecurityRow):
            DcmDspSecurityDelayTime = 180.0
            DcmDspSecurityDelayTimeOnBoot = 0.0
            DcmDspSecurityKeySize = 0x08
            DcmDspSecurityLevel = 0x09
            DcmDspSecurityNumAttDelay = 0x03
            DcmDspSecuritySeedSize = 0x08
            DcmDspSecurityUsePort = USE_ASYNCH_CLIENT_SERVER
        ES95486_SESSION (DcmDspSession)
          9 x DcmDspSessionRow, all with DcmDspSessionP2ServerMax=0.05, DcmDspSessionP2StarServerMax=5.0:
            DCM_DEFAULT_SESSION: DcmDspSessionForBoot=DCM_NO_BOOT, DcmDspSessionLevel=0x01
            DCM_PROGRAMMING_SESSION: DcmDspSessionForBoot=DCM_OEM_BOOT, DcmDspSessionLevel=0x02
            DCM_EXTENDED_DIAGNOSTIC_SESSION: DcmDspSessionForBoot=DCM_NO_BOOT, DcmDspSessionLevel=0x03
            DCM_SAFETY_SYSTEM_DIAGNOSTIC_SESSION: DcmDspSessionForBoot=DCM_NO_BOOT, DcmDspSessionLevel=0x04
            DCM_ECU_PROGRAMMING_MODE: DcmDspSessionForBoot=DCM_OEM_BOOT, DcmDspSessionLevel=0x05
            DCM_EXTENDED_DIAGNOSTIC_MODE: DcmDspSessionForBoot=DCM_NO_BOOT, DcmDspSessionLevel=0x10
            DCM_QUIESCENT_CURRENT_DIAGNOSTIC_MODE: DcmDspSessionForBoot=DCM_NO_BOOT, DcmDspSessionLevel=0x50
            DCM_SLEEP_MODE_START_REQUEST: DcmDspSessionForBoot=DCM_NO_BOOT, DcmDspSessionLevel=0x51
            DCM_ALL_SESSION_LEVEL: DcmDspSessionForBoot=DCM_NO_BOOT, DcmDspSessionLevel=0xFF
        DcmDspComControl
          CommChannel_LCAN (DcmDspComControlAllChannel): DcmDspAllComMChannelRef=ComMChannel_LCAN
          SpecificCommChannel_LCAN (DcmDspComControlSpecificChannel): DcmDspSubnetNumber=0x01, DcmDspSpecificComMChannelRef=ComMChannel_LCAN
        DID_B002h_UWB_BLE_Master_Calibration (DcmDspDid): DcmDspDidIdentifier=0xB002, DcmDspDidUsed=1, DcmDspDidInfoRef=DIDInfo_ReadDataByIdentifier
          UWB_BLE_Master_Calibration (DcmDspDidSignal): DcmDspDidDataPos=0x00, DcmDspDidDataRef=DcmDsp/UWB_BLE_Master_Calibration
        UWB_BLE_Master_Calibration (DcmDspData): DcmDspDataUsePort=USE_DATA_SYNCH_CLIENT_SERVER, DcmDspDataType=UINT8, DcmDspDataSize=0x118, DcmDspDataInfoRef=NoScalingInfomation_FixedData
        33 x DcmDspDid, all with DcmDspDidUsed=1, DcmDspDidInfoRef=DIDInfo_ReadDataByIdentifier:
          DID_B003h_UWB_BLE_Master_Option_Configuration: DcmDspDidIdentifier=0xB003
            UWB_BLE_Master_Option_Configuration (DcmDspDidSignal): DcmDspDidDataPos=0x00, DcmDspDidDataRef=DcmDsp/UWB_BLE_Master_Option_Configuration
          DID_B005h_Logic_Inputs_Status: DcmDspDidIdentifier=0xB005
            Logic_Inputs_Status (DcmDspDidSignal): DcmDspDidDataPos=0x00, DcmDspDidDataRef=DcmDsp/Logic_Inputs_Status
          DID_B006h_Analog_and_PWM_Inputs_Status: DcmDspDidIdentifier=0xB006
            Analog_and_PWM_Inputs_Status (DcmDspDidSignal): DcmDspDidDataPos=0x00, DcmDspDidDataRef=DcmDsp/Analog_and_PWM_Inputs_Status
          DID_B00Ah_Access_control_Status_bit_frame: DcmDspDidIdentifier=0xB00A
            Access_control_Status_bit_frame (DcmDspDidSignal): DcmDspDidDataPos=0x00, DcmDspDidDataRef=DcmDsp/Access_control_Status_bit_frame
          DID_B00Bh_Access_control_Status_Byte_frame: DcmDspDidIdentifier=0xB00B
            Access_control_Status_Byte_frame (DcmDspDidSignal): DcmDspDidDataPos=0x00, DcmDspDidDataRef=DcmDsp/Access_control_Status_Byte_frame
          DID_F187h_Vehicle_Part_Number: DcmDspDidIdentifier=0xF187
            Vehicle_Part_Number (DcmDspDidSignal): DcmDspDidDataPos=0x00, DcmDspDidDataRef=DcmDsp/Vehicle_Part_Number
          DID_F18Bh_Supplier_HW_Manufacturing_Date: DcmDspDidIdentifier=0xF18B
            Supplier_HW_Manufacturing_Date (DcmDspDidSignal): DcmDspDidDataPos=0x00, DcmDspDidDataRef=DcmDsp/Supplier_HW_Manufacturing_Date
          DID_F18Ch_Serial_Number: DcmDspDidIdentifier=0xF18C
            Serial_Number (DcmDspDidSignal): DcmDspDidDataPos=0x00, DcmDspDidDataRef=DcmDsp/Serial_Number
          DID_F197h_System_Name: DcmDspDidIdentifier=0xF197
            System_Name (DcmDspDidSignal): DcmDspDidDataPos=0x00, DcmDspDidDataRef=DcmDsp/System_Name
          DID_F1A0h_Vehicle_SW_Version: DcmDspDidIdentifier=0xF1A0
            Vehicle_SW_Version (DcmDspDidSignal): DcmDspDidDataPos=0x00, DcmDspDidDataRef=DcmDsp/Vehicle_SW_Version
          DID_F1A1h_System_Supplier_Code: DcmDspDidIdentifier=0xF1A1
            System_Supplier_Code (DcmDspDidSignal): DcmDspDidDataPos=0x00, DcmDspDidDataRef=DcmDsp/System_Supplier_Code
          DID_F1A4h_Local_CAN_Database_Version: DcmDspDidIdentifier=0xF1A4
            Local_CAN_Database_Version (DcmDspDidSignal): DcmDspDidDataPos=0x00, DcmDspDidDataRef=DcmDsp/Local_CAN_Database_Version
          DID_F1ACh_UWB_HW_Version: DcmDspDidIdentifier=0xF1AC
            UWB_HW_Version (DcmDspDidSignal): DcmDspDidDataPos=0x00, DcmDspDidDataRef=DcmDsp/UWB_HW_Version
          DID_F1B0h_The_Number_of_SW_Unit: DcmDspDidIdentifier=0xF1B0
            The_Number_of_SW_Unit (DcmDspDidSignal): DcmDspDidDataPos=0x00, DcmDspDidDataRef=DcmDsp/The_Number_of_SW_Unit
          DID_F1B1h_ECUSoftwareUNIT1VersionDataIdentifier: DcmDspDidIdentifier=0xF1B1
            ECUSoftwareUNIT1VersionDataIdentifier (DcmDspDidSignal): DcmDspDidDataPos=0x00, DcmDspDidDataRef=DcmDsp/ECUSoftwareUNIT1VersionDataIdentifier
          DID_F1B2h_ECUSoftwareUNIT2VersionDataIdentifier: DcmDspDidIdentifier=0xF1B2
            ECUSoftwareUNIT2VersionDataIdentifier (DcmDspDidSignal): DcmDspDidDataPos=0x00, DcmDspDidDataRef=DcmDsp/ECUSoftwareUNIT2VersionDataIdentifier
          DID_F1B3h_ECUSoftwareUNIT3VersionDataIdentifier: DcmDspDidIdentifier=0xF1B3
            ECUSoftwareUNIT3VersionDataIdentifier (DcmDspDidSignal): DcmDspDidDataPos=0x00, DcmDspDidDataRef=DcmDsp/ECUSoftwareUNIT3VersionDataIdentifier
          DID_F1B4h_ECUSoftwareUNIT4VersionDataIdentifier: DcmDspDidIdentifier=0xF1B4
            ECUSoftwareUNIT4VersionDataIdentifier (DcmDspDidSignal): DcmDspDidDataPos=0x00, DcmDspDidDataRef=DcmDsp/ECUSoftwareUNIT4VersionDataIdentifier
          DID_F1C1h_ECUSoftwareUnit1IVDDataIdentifier: DcmDspDidIdentifier=0xF1C1
            ECUSoftwareUnit1IVDDataIdentifier (DcmDspDidSignal): DcmDspDidDataPos=0x00, DcmDspDidDataRef=DcmDsp/ECUSoftwareUnit1IVDDataIdentifier
          DID_F1C2h_ECUSoftwareUnit2IVDDataIdentifier: DcmDspDidIdentifier=0xF1C2
            ECUSoftwareUnit2IVDDataIdentifier (DcmDspDidSignal): DcmDspDidDataPos=0x00, DcmDspDidDataRef=DcmDsp/ECUSoftwareUnit2IVDDataIdentifier
          DID_F1C3h_ECUSoftwareUnit3IVDDataIdentifier: DcmDspDidIdentifier=0xF1C3
            ECUSoftwareUnit3IVDDataIdentifier (DcmDspDidSignal): DcmDspDidDataPos=0x00, DcmDspDidDataRef=DcmDsp/ECUSoftwareUnit3IVDDataIdentifier
          DID_F1C4h_ECUSoftwareUnit4IVDDataIdentifier: DcmDspDidIdentifier=0xF1C4
            ECUSoftwareUnit4IVDDataIdentifier (DcmDspDidSignal): DcmDspDidDataPos=0x00, DcmDspDidDataRef=DcmDsp/ECUSoftwareUnit4IVDDataIdentifier
          DID_F1EFh_LocalRXSWINDataIdentifier: DcmDspDidIdentifier=0xF1EF
            LocalRXSWINDataIdentifier (DcmDspDidSignal): DcmDspDidDataPos=0x00, DcmDspDidDataRef=DcmDsp/LocalRXSWINDataIdentifier
          DID_FD00h_UWB_BLE_Master_Version_Data: DcmDspDidIdentifier=0xFD00
            UWB_BLE_Master_Version_Data (DcmDspDidSignal): DcmDspDidDataPos=0x00, DcmDspDidDataRef=DcmDsp/UWB_BLE_Master_Version_Data
          DID_FD01h_UWB_FL_Version_Data: DcmDspDidIdentifier=0xFD01
            UWB_FL_Version_Data (DcmDspDidSignal): DcmDspDidDataPos=0x00, DcmDspDidDataRef=DcmDsp/UWB_FL_Version_Data
          DID_FD02h_UWB_FR_Version_Data: DcmDspDidIdentifier=0xFD02
            UWB_FR_Version_Data (DcmDspDidSignal): DcmDspDidDataPos=0x00, DcmDspDidDataRef=DcmDsp/UWB_FR_Version_Data
          DID_FD03h_UWB_RR_Version_Data: DcmDspDidIdentifier=0xFD03
            UWB_RR_Version_Data (DcmDspDidSignal): DcmDspDidDataPos=0x00, DcmDspDidDataRef=DcmDsp/UWB_RR_Version_Data
          DID_FD04h_UWB_RL_Version_Data: DcmDspDidIdentifier=0xFD04
            UWB_RL_Version_Data (DcmDspDidSignal): DcmDspDidDataPos=0x00, DcmDspDidDataRef=DcmDsp/UWB_RL_Version_Data
          DID_FD05h_UWB_BLE_Slave_Version_Data: DcmDspDidIdentifier=0xFD05
            UWB_BLE_Slave_Version_Data (DcmDspDidSignal): DcmDspDidDataPos=0x00, DcmDspDidDataRef=DcmDsp/UWB_BLE_Slave_Version_Data
          DID_FD06h_UWB_Trunk_Version_Data: DcmDspDidIdentifier=0xFD06
            UWB_Trunk_Version_Data (DcmDspDidSignal): DcmDspDidDataPos=0x00, DcmDspDidDataRef=DcmDsp/UWB_Trunk_Version_Data
          DID_FD07h_UWB_Frunk_Version_Data: DcmDspDidIdentifier=0xFD07
            UWB_Frunk_Version_Data (DcmDspDidSignal): DcmDspDidDataPos=0x00, DcmDspDidDataRef=DcmDsp/UWB_Frunk_Version_Data
          DID_FD10h_Localization_Lib_Version_Data: DcmDspDidIdentifier=0xFD10
            Localization_Lib_Version_Data (DcmDspDidSignal): DcmDspDidDataPos=0x00, DcmDspDidDataRef=DcmDsp/Localization_Lib_Version_Data
          DID_FD11h_Localization_Lib_Vehicle_Part_Number: DcmDspDidIdentifier=0xFD11
            Localization_Lib_Vehicle_Part_Number (DcmDspDidSignal): DcmDspDidDataPos=0x00, DcmDspDidDataRef=DcmDsp/Localization_Lib_Vehicle_Part_Number
        33 x DcmDspData, all with DcmDspDataType=UINT8, DcmDspDataUsePort=USE_DATA_SYNCH_CLIENT_SERVER:
          UWB_BLE_Master_Option_Configuration: DcmDspDataSize=0x40, DcmDspDataInfoRef=NoScalingInfomation_FixedData
          Logic_Inputs_Status: DcmDspDataSize=0x40, DcmDspDataInfoRef=NoScalingInfomation_FixedData
          Analog_and_PWM_Inputs_Status: DcmDspDataSize=0xA0, DcmDspDataInfoRef=NoScalingInfomation_FixedData
          Access_control_Status_bit_frame: DcmDspDataSize=0x40, DcmDspDataInfoRef=NoScalingInfomation_FixedData
          Access_control_Status_Byte_frame: DcmDspDataSize=0x100, DcmDspDataInfoRef=NoScalingInfomation_FixedData
          Vehicle_Part_Number: DcmDspDataSize=0x50, DcmDspDataInfoRef=NoScalingInfomation_FixedData
          Supplier_HW_Manufacturing_Date: DcmDspDataSize=0x20, DcmDspDataInfoRef=NoScalingInfomation_FixedData
          Serial_Number: DcmDspDataSize=0x78, DcmDspDataInfoRef=NoScalingInfomation_FixedData
          System_Name: DcmDspDataSize=0x18, DcmDspDataInfoRef=NoScalingInfomation_FixedData
          Vehicle_SW_Version: DcmDspDataSize=0x20, DcmDspDataInfoRef=NoScalingInfomation_FixedData
          System_Supplier_Code: DcmDspDataSize=0x20, DcmDspDataInfoRef=NoScalingInfomation_FixedData
          Local_CAN_Database_Version: DcmDspDataSize=0x20, DcmDspDataInfoRef=NoScalingInfomation_FixedData
          UWB_HW_Version: DcmDspDataSize=0x20, DcmDspDataInfoRef=NoScalingInfomation_FixedData
          The_Number_of_SW_Unit: DcmDspDataSize=0x08, DcmDspDataInfoRef=NoScalingInfomation_FixedData
          ECUSoftwareUNIT{1..4}VersionDataIdentifier: DcmDspDataSize=0x20, DcmDspDataInfoRef=NoScalingInfomation_FixedData
          ECUSoftwareUnit{1..4}IVDDataIdentifier: DcmDspDataSize=0x100, DcmDspDataInfoRef=NoScalingInfomation_FixedData
          LocalRXSWINDataIdentifier: DcmDspDataSize=0x320, DcmDspDataInfoRef=NoScalingInfomation_VariableData
          UWB_BLE_Master_Version_Data: DcmDspDataSize=0x80, DcmDspDataInfoRef=NoScalingInfomation_FixedData
          UWB_FL_Version_Data: DcmDspDataSize=0x60, DcmDspDataInfoRef=NoScalingInfomation_FixedData
          UWB_FR_Version_Data: DcmDspDataSize=0x60, DcmDspDataInfoRef=NoScalingInfomation_FixedData
          UWB_RR_Version_Data: DcmDspDataSize=0x60, DcmDspDataInfoRef=NoScalingInfomation_FixedData
          UWB_RL_Version_Data: DcmDspDataSize=0x60, DcmDspDataInfoRef=NoScalingInfomation_FixedData
          UWB_BLE_Slave_Version_Data: DcmDspDataSize=0x80, DcmDspDataInfoRef=NoScalingInfomation_FixedData
          UWB_Trunk_Version_Data: DcmDspDataSize=0x60, DcmDspDataInfoRef=NoScalingInfomation_FixedData
          UWB_Frunk_Version_Data: DcmDspDataSize=0x60, DcmDspDataInfoRef=NoScalingInfomation_FixedData
          Localization_Lib_Version_Data: DcmDspDataSize=0x38, DcmDspDataInfoRef=NoScalingInfomation_FixedData
          Localization_Lib_Vehicle_Part_Number: DcmDspDataSize=0x28, DcmDspDataInfoRef=NoScalingInfomation_FixedData
        3 x DcmDspDidInfo, all with DcmDspDidDynamicallyDefined=0:
          DIDInfo_ReadDataByIdentifier
            DcmDspDidAccess
              DcmDspDidRead
          DIDInfo_WriteDataByIdentifier
            DcmDspDidAccess
              DcmDspDidWrite:
                DcmDspDidWriteSecurityLevelRef = L9
                DcmDspDidWriteSessionRef = DCM_EXTENDED_DIAGNOSTIC_MODE
                DcmDspDidWriteSessionRef = DCM_EXTENDED_DIAGNOSTIC_SESSION
          DIDInfo_InputOutputControlByIdentifier
            DcmDspDidAccess
              DcmDspDidControl: DcmDspDidControlSessionRef=DCM_EXTENDED_DIAGNOSTIC_MODE, DcmDspDidControlSessionRef=DCM_EXTENDED_DIAGNOSTIC_SESSION
              DcmDspDidRead: DcmDspDidReadSessionRef=DCM_EXTENDED_DIAGNOSTIC_MODE, DcmDspDidReadSessionRef=DCM_EXTENDED_DIAGNOSTIC_SESSION
              DcmDspDidWrite: DcmDspDidWriteSessionRef=DCM_EXTENDED_DIAGNOSTIC_MODE, DcmDspDidWriteSessionRef=DCM_EXTENDED_DIAGNOSTIC_SESSION
        3 x DcmDspDid, all with DcmDspDidUsed=1, DcmDspDidInfoRef=DIDInfo_WriteDataByIdentifier:
          DID_0402h_EOL_Programming: DcmDspDidIdentifier=0x402
            EOL_Programming (DcmDspDidSignal): DcmDspDidDataPos=0x00, DcmDspDidDataRef=DcmDsp/EOL_Programming
          DID_12A0h_User_Option_Write: DcmDspDidIdentifier=0x12A0
            User_Option_Write (DcmDspDidSignal): DcmDspDidDataPos=0x00, DcmDspDidDataRef=DcmDsp/User_Option_Write
          DID_12A2h_Calibration_Parameter: DcmDspDidIdentifier=0x12A2
            Calibration_Parameter (DcmDspDidSignal): DcmDspDidDataPos=0x00, DcmDspDidDataRef=DcmDsp/Calibration_Parameter
        3 x DcmDspData, all with DcmDspDataType=UINT8, DcmDspDataUsePort=USE_DATA_ASYNCH_CLIENT_SERVER, DcmDspDataInfoRef=NoScalingInfomation_FixedData:
          EOL_Programming: DcmDspDataSize=0x20
          User_Option_Write: DcmDspDataSize=0x10
          Calibration_Parameter: DcmDspDataSize=0x10
      DcmGeneral:
        DcmDevErrorDetect = 1
        DcmRequestManufacturerNotificationEnabled = 0
        DcmRequestSupplierNotificationEnabled = 1
        DcmRespondAllRequest = 1
        DcmTaskTime = 0.01
        DcmVersionInfoApi = 0
        DcmStandardSupport = DCM_ES95486_02_SUPPORT
        DcmAutronFblUsed = 1
        DcmForcedEcuReset = 0
        DcmSecureFlashSupport = 0
        DemIntegrated = 1
      DcmPageBufferCfg: DcmPagedBufferEnabled=0
